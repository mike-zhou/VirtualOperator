# file: VirtualOperator.ioc
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CORTEX_M7.default_mode_Activation=1
HRTIM.Periode_TA=0x7000
HRTIM.PrescalerRatio_TA=HRTIM_PRESCALERRATIO_DIV4
Mcu.Family=STM32H7
Mcu.Name=STM32H753BITx
Mcu.Package=LQFP208
NVIC.HRTIM1_TIMA_IRQn=true\:6\:0\:true\:false\:true\:true\:true\:true
NVIC.OTG_FS_EP1_IN_IRQn=true\:10\:0\:true\:false\:true\:true\:true\:true
NVIC.OTG_FS_EP1_OUT_IRQn=true\:10\:0\:true\:false\:true\:true\:true\:true
NVIC.OTG_FS_IRQn=true\:10\:0\:true\:false\:true\:true\:true\:true
NVIC.OTG_HS_EP1_IN_IRQn=true\:10\:0\:true\:false\:true\:true\:true\:true
NVIC.OTG_HS_EP1_OUT_IRQn=true\:10\:0\:true\:false\:true\:true\:true\:true
NVIC.OTG_HS_IRQn=true\:10\:0\:true\:false\:true\:true\:true\:true
NVIC.PriorityGroup=NVIC_PRIORITYGROUP_4
NVIC.TIM15_IRQn=true\:5\:0\:true\:false\:true\:true\:true\:true
NVIC.TIM16_IRQn=true\:5\:0\:true\:false\:true\:true\:true\:true
NVIC.TIM17_IRQn=true\:5\:0\:true\:false\:true\:true\:true\:true
NVIC.TIM8_BRK_TIM12_IRQn=true\:5\:0\:true\:false\:true\:true\:true\:true
NVIC.TIM8_TRG_COM_TIM14_IRQn=true\:5\:0\:true\:false\:true\:true\:true\:true
NVIC.TIM8_UP_TIM13_IRQn=true\:5\:0\:true\:false\:true\:true\:true\:true
NVIC.USART1_IRQn=true\:12\:0\:true\:false\:true\:true\:true\:true
PA0.GPIO_Label=EA_0
PA0.Signal=S_TIM2_CH1_ETR
PA1.GPIO_Label=EB_0
PA1.Signal=S_TIM2_CH2
PA10.Mode=Asynchronous
PA10.Signal=USART1_RX
PA11.Mode=Device_Only
PA11.Signal=USB_OTG_FS_DM
PA12.Mode=Device_Only
PA12.Signal=USB_OTG_FS_DP
PA13\ (JTMS/SWDIO).Mode=JTAG_4_pins
PA13\ (JTMS/SWDIO).Signal=DEBUG_JTMS-SWDIO
PA14\ (JTCK/SWCLK).Mode=JTAG_4_pins
PA14\ (JTCK/SWCLK).Signal=DEBUG_JTCK-SWCLK
PA15\ (JTDI).Mode=JTAG_4_pins
PA15\ (JTDI).Signal=DEBUG_JTDI
PA2.GPIO_Label=GP24_in
PA2.Signal=GPIO_Input
PA4.GPIO_Label=GP28_in
PA4.Signal=GPIO_Input
PA6.GPIO_Label=CLK_STP3
PA6.Signal=GPIO_Output
PA7.GPIO_Label=CLK_STP4
PA7.Signal=GPIO_Output
PA8.Mode=Clock-out-1
PA8.Signal=RCC_MCO_1
PA9.Mode=Asynchronous
PA9.Signal=USART1_TX
PB14.Mode=Device_Only_FS
PB14.Signal=USB_OTG_HS_DM
PB15.Mode=Device_Only_FS
PB15.Signal=USB_OTG_HS_DP
PB2.GPIO_Label=GP32_in
PB2.Signal=GPIO_Input
PB3\ (JTDO/TRACESWO).Mode=JTAG_4_pins
PB3\ (JTDO/TRACESWO).Signal=DEBUG_JTDO-SWO
PB4\ (NJTRST).GPIO_Label=GP109_in
PB4\ (NJTRST).Signal=GPIO_Input
PB6.GPIO_Label=EA_5
PB6.Signal=S_TIM4_CH1
PB7.GPIO_Label=GP110_in
PB7.Signal=GPIO_Input
PB8.GPIO_Label=GP111_in
PB8.Signal=GPIO_Input
PB9.GPIO_Label=GP112_out
PB9.Signal=GPIO_Output
PC1.GPIO_Label=GP22_in
PC1.Signal=GPIO_Input
PC10.GPIO_Label=GP83_in
PC10.Signal=GPIO_Input
PC11.GPIO_Label=GP84_out
PC11.Signal=GPIO_Output
PC12.GPIO_Label=GP85_in
PC12.Signal=GPIO_Input
PC13.GPIO_Label=GP5_out
PC13.Signal=GPIO_Output
PC14-OSC32_IN\ (OSC32_IN).GPIO_Label=GP6_in
PC14-OSC32_IN\ (OSC32_IN).Signal=GPIO_Input
PC15-OSC32_OUT\ (OSC32_OUT).GPIO_Label=GP7_out
PC15-OSC32_OUT\ (OSC32_OUT).Signal=GPIO_Output
PC2_C.GPIO_Label=GP23_in
PC2_C.Signal=GPIO_Input
PC4.GPIO_Label=GP29_in
PC4.Signal=GPIO_Input
PC5.GPIO_Label=GP30_in
PC5.Signal=GPIO_Input
PC6.GPIO_Label=EA_7
PC6.Signal=S_TIM3_CH1
PC7.GPIO_Label=EB_7
PC7.Signal=S_TIM3_CH2
PC8.GPIO_Label=GP75_in
PC8.Signal=GPIO_Input
PC9.GPIO_Label=GP76_in
PC9.Signal=GPIO_Input
PD0.GPIO_Label=GP86_in
PD0.Signal=GPIO_Input
PD1.GPIO_Label=GP87_in
PD1.Signal=GPIO_Input
PD10.GPIO_Label=GP58_out
PD10.Signal=GPIO_Output
PD11.GPIO_Label=EB_4
PD11.Mode=Encoder_mode_occur1
PD11.Signal=LPTIM2_IN2
PD12.GPIO_Label=EA_4
PD12.Mode=Encoder_mode_occur1
PD12.Signal=LPTIM2_IN1
PD13.GPIO_Label=EB_5
PD13.Signal=S_TIM4_CH2
PD14.GPIO_Label=GP59_out
PD14.Signal=GPIO_Output
PD15.GPIO_Label=GP60_out
PD15.Signal=GPIO_Output
PD2.GPIO_Label=GP88_in
PD2.Signal=GPIO_Input
PD3.GPIO_Label=GP89_in
PD3.Signal=GPIO_Input
PD4.GPIO_Label=GP90_in
PD4.Signal=GPIO_Input
PD5.GPIO_Label=GP91_in
PD5.Signal=GPIO_Input
PD6.GPIO_Label=GP92_in
PD6.Signal=GPIO_Input
PD7.GPIO_Label=GP93_in
PD7.Signal=GPIO_Input
PD8.GPIO_Label=USB_DEC_1_out
PD8.Signal=GPIO_Output
PD9.GPIO_Label=GP57_out
PD9.Signal=GPIO_Output
PE0.GPIO_Label=GP113_out
PE0.Signal=GPIO_Output
PE1.GPIO_Label=GP114_out
PE1.Signal=GPIO_Output
PE10.GPIO_Label=GP47_in
PE10.Signal=GPIO_Input
PE11.GPIO_Label=EB_2
PE11.Signal=S_TIM1_CH2
PE12.GPIO_Label=GP48_in
PE12.Signal=GPIO_Input
PE13.GPIO_Label=GP49_in
PE13.Signal=GPIO_Input
PE14.GPIO_Label=GP50_in
PE14.Signal=GPIO_Input
PE15.GPIO_Label=GP51_in
PE15.Signal=GPIO_Input
PE2.GPIO_Label=GP0_in
PE2.Signal=GPIO_Input
PE3.GPIO_Label=GP1_out
PE3.Signal=GPIO_Output
PE4.GPIO_Label=GP2_out
PE4.Signal=GPIO_Output
PE5.GPIO_Label=CLK_STP0
PE5.Signal=GPIO_Output
PE6.GPIO_Label=GP3_out
PE6.Signal=GPIO_Output
PE7.GPIO_Label=GP45_in
PE7.Signal=GPIO_Input
PE8.GPIO_Label=GP46_in
PE8.Signal=GPIO_Input
PE9.GPIO_Label=EA_2
PE9.Signal=S_TIM1_CH1
PF0.GPIO_Label=GP10_in
PF0.Signal=GPIO_Input
PF1.GPIO_Label=GP11_in
PF1.Signal=GPIO_Input
PF10.GPIO_Label=GP21_in
PF10.Signal=GPIO_Input
PF11.GPIO_Label=GP38_in
PF11.Signal=GPIO_Input
PF12.GPIO_Label=GP39_in
PF12.Signal=GPIO_Input
PF13.GPIO_Label=GP40_in
PF13.Signal=GPIO_Input
PF14.GPIO_Label=GP41_in
PF14.Signal=GPIO_Input
PF15.GPIO_Label=GP42_in
PF15.Signal=GPIO_Input
PF2.GPIO_Label=GP12_in
PF2.Signal=GPIO_Input
PF3.GPIO_Label=GP16_in
PF3.Signal=GPIO_Input
PF4.GPIO_Label=GP71_in
PF4.Signal=GPIO_Input
PF5.GPIO_Label=GP18_in
PF5.Signal=GPIO_Input
PF6.GPIO_Label=CLK_STP1
PF6.Signal=GPIO_Output
PF7.GPIO_Label=CLK_STP2
PF7.Signal=GPIO_Output
PF8.GPIO_Label=GP19_in
PF8.Signal=GPIO_Input
PF9.GPIO_Label=GP20_in
PF9.Signal=GPIO_Input
PG0.GPIO_Label=GP43_in
PG0.Signal=GPIO_Input
PG1.GPIO_Label=GP44_in
PG1.Signal=GPIO_Input
PG10.GPIO_Label=GP99_in
PG10.Signal=GPIO_Input
PG11.GPIO_Label=GP100_in
PG11.Signal=GPIO_Input
PG12.GPIO_Label=EB_1
PG12.Mode=Encoder_mode_occur1
PG12.Signal=LPTIM1_IN1
PG13.GPIO_Label=GP101_in
PG13.Signal=GPIO_Input
PG14.GPIO_Label=GP102_in
PG14.Signal=GPIO_Input
PG15.GPIO_Label=GP108_in
PG15.Signal=GPIO_Input
PG2.GPIO_Label=GP68_out
PG2.Signal=GPIO_Output
PG3.GPIO_Label=GP69_out
PG3.Signal=GPIO_Output
PG4.GPIO_Label=GP70_out
PG4.Signal=GPIO_Output
PG5.GPIO_Label=GP71_out
PG5.Signal=GPIO_Output
PG6.GPIO_Label=GP72_out
PG6.Signal=GPIO_Output
PG7.GPIO_Label=GP73_out
PG7.Signal=GPIO_Output
PG8.GPIO_Label=GP74_out
PG8.Signal=GPIO_Output
PG9.GPIO_Label=GP98_out
PG9.Signal=GPIO_Output
PH0-OSC_IN\ (PH0).Mode=HSE-External-Oscillator
PH0-OSC_IN\ (PH0).Signal=RCC_OSC_IN
PH1-OSC_OUT\ (PH1).Mode=HSE-External-Oscillator
PH1-OSC_OUT\ (PH1).Signal=RCC_OSC_OUT
PH10.GPIO_Label=EA_3
PH10.Signal=S_TIM5_CH1
PH11.GPIO_Label=EB_3
PH11.Signal=S_TIM5_CH2
PH12.GPIO_Label=GP56_out
PH12.Signal=GPIO_Output
PH13.GPIO_Label=USB_DEC_0_in
PH13.Signal=GPIO_Input
PH14.GPIO_Label=GP77_in
PH14.Signal=GPIO_Input
PH15.GPIO_Label=GP78_out
PH15.Signal=GPIO_Output
PH2.GPIO_Label=EA_1
PH2.Mode=Encoder_mode_occur1
PH2.Signal=LPTIM1_IN2
PH3.GPIO_Label=GP25_in
PH3.Signal=GPIO_Input
PH4.GPIO_Label=GP26_in
PH4.Signal=GPIO_Input
PH5.GPIO_Label=GP27_in
PH5.Signal=GPIO_Input
PH6.GPIO_Label=CLK_STP5
PH6.Signal=GPIO_Output
PH7.GPIO_Label=GP53_out
PH7.Signal=GPIO_Output
PH8.GPIO_Label=GP54_out
PH8.Signal=GPIO_Output
PH9.GPIO_Label=GP55_out
PH9.Signal=GPIO_Output
PI0.GPIO_Label=GP79_out
PI0.Signal=GPIO_Output
PI1.GPIO_Label=GP80_in
PI1.Signal=GPIO_Input
PI10.GPIO_Label=GP9_in
PI10.Signal=GPIO_Input
PI12.GPIO_Label=GP13_in
PI12.Signal=GPIO_Input
PI13.GPIO_Label=GP14_in
PI13.Signal=GPIO_Input
PI14.GPIO_Label=GP15_in
PI14.Signal=GPIO_Input
PI15.GPIO_Label=GP32_in
PI15.Signal=GPIO_Input
PI2.GPIO_Label=GP81_in
PI2.Signal=GPIO_Input
PI3.GPIO_Label=GP82_out
PI3.Signal=GPIO_Output
PI4.GPIO_Label=GP115_out
PI4.Signal=GPIO_Output
PI5.GPIO_Label=GP116_in
PI5.Signal=GPIO_Input
PI6.GPIO_Label=GP117_in
PI6.Signal=GPIO_Input
PI7.GPIO_Label=GP118_out
PI7.Signal=GPIO_Output
PI8.GPIO_Label=GP4_in
PI8.Signal=GPIO_Input
PI9.GPIO_Label=GP8_out
PI9.Signal=GPIO_Output
PJ0.GPIO_Label=GP33_in
PJ0.Signal=GPIO_Input
PJ1.GPIO_Label=GP34_in
PJ1.Signal=GPIO_Input
PJ10.GPIO_Label=GP63_out
PJ10.Signal=GPIO_Output
PJ11.GPIO_Label=GP64_out
PJ11.Signal=GPIO_Output
PJ12.GPIO_Label=GP94_in
PJ12.Signal=GPIO_Input
PJ13.GPIO_Label=GP95_in
PJ13.Signal=GPIO_Input
PJ14.GPIO_Label=GP96_out
PJ14.Signal=GPIO_Output
PJ15.GPIO_Label=GP97_in
PJ15.Signal=GPIO_Input
PJ2.GPIO_Label=GP35_in
PJ2.Signal=GPIO_Input
PJ3.GPIO_Label=GP36_in
PJ3.Signal=GPIO_Input
PJ4.GPIO_Label=GP37_in
PJ4.Signal=GPIO_Input
PJ5.GPIO_Label=GP52_out
PJ5.Signal=GPIO_Output
PJ6.GPIO_Label=EB_6
PJ6.Signal=S_TIM8_CH2
PJ7.GPIO_Label=GP61_out
PJ7.Signal=GPIO_Output
PJ8.GPIO_Label=EA_6
PJ8.Signal=S_TIM8_CH1
PJ9.GPIO_Label=GP62_out
PJ9.Signal=GPIO_Output
PK0.GPIO_Label=GP65_out
PK0.Signal=GPIO_Output
PK1.GPIO_Label=GP66_out
PK1.Signal=GPIO_Output
PK2.GPIO_Label=GP67_out
PK2.Signal=GPIO_Output
PK3.GPIO_Label=GP103_in
PK3.Signal=GPIO_Input
PK4.GPIO_Label=GP104_out
PK4.Signal=GPIO_Output
PK5.GPIO_Label=GP105_in
PK5.Signal=GPIO_Input
PK6.GPIO_Label=GP106_in
PK6.Signal=GPIO_Input
PK7.GPIO_Label=GP107_out
PK7.Signal=GPIO_Output
ProjectManager.HeapSize=0x200
ProjectManager.StackSize=0x400
ProjectManager.TargetToolchain=STM32CubeIDE
RCC.ADCCLockSelection=RCC_ADCCLKSOURCE_PLL2
RCC.ADCFreq_Value=129000000
RCC.APB1Freq_Value=120000000
RCC.APB2Freq_Value=120000000
RCC.APB3Freq_Value=120000000
RCC.APB4Freq_Value=120000000
RCC.CECCLockSelection=RCC_CECCLKSOURCE_LSI
RCC.CKPERSourceSelection=RCC_CLKPSOURCE_HSI
RCC.CSI_VALUE=4000000
RCC.CortexFreq_Value=480000000
RCC.Cortex_Div=SYSTICK_CLKSOURCE_HCLK
RCC.Cortex_DivARG=SystemCoreClock/1000
RCC.D1CPRE=RCC_SYSCLK_DIV1
RCC.D1PPRE=RCC_APB3_DIV2
RCC.D2PPRE1=RCC_APB1_DIV2
RCC.D2PPRE2=RCC_APB2_DIV2
RCC.D3PPRE=RCC_APB4_DIV2
RCC.DFSDMCLockSelection=RCC_DFSDM1CLKSOURCE_D2PCLK1
RCC.DIVM1=4
RCC.DIVM2=32
RCC.DIVM3=32
RCC.DIVN1=60
RCC.DIVN2=129
RCC.DIVN3=129
RCC.DIVP2=2
RCC.DIVP3=2
RCC.DIVQ1=3
RCC.DIVQ2=2
RCC.DIVQ3=2
RCC.DIVR1=2
RCC.DIVR2=2
RCC.DIVR3=2
RCC.DSICLockSelection=RCC_DSICLKSOURCE_PHY
RCC.DSIPHY_Div=8
RCC.DSITX_Div=4
RCC.DSI_PHY_VALUE=12288000
RCC.EXTERNAL_CLOCK_VALUE=12288000
RCC.FDCANCLockSelection=RCC_FDCANCLKSOURCE_PLL
RCC.FMCCLockSelection=RCC_FMCCLKSOURCE_D1HCLK
RCC.HCLKFreq_Value=240000000
RCC.HPRE=RCC_HCLK_DIV2
RCC.HSE_VALUE=24000000
RCC.HSIDiv=RCC_PLLSAIDIVR_1
RCC.HSI_VALUE=64000000
RCC.I2C123CLockSelection=RCC_I2C123CLKSOURCE_D2PCLK1
RCC.I2C4CLockSelection=RCC_I2C4CLKSOURCE_D3PCLK1
RCC.LPTIM1CLockSelection=RCC_LPTIM1CLKSOURCE_D2PCLK1
RCC.LPTIM2CLockSelection=RCC_LPTIM2CLKSOURCE_D3PCLK1
RCC.LPTIM345CLockSelection=RCC_LPTIM345CLKSOURCE_D3PCLK1
RCC.LPUART1CLockSelection=RCC_LPUART1CLKSOURCE_D3PCLK1
RCC.LSEState=RCC_LSE_OFF
RCC.LSE_VALUE=32768
RCC.PLL2_VCI_Range-AdvancedSettings=RCC_PLL2VCIRANGE_1
RCC.PLLDSIDev=2
RCC.PLLDSIIDF=DSI_PLL_IN_DIV1
RCC.PLLDSIMult=2
RCC.PLLDSINDIV=20
RCC.PLLDSIODF=DSI_PLL_OUT_DIV1
RCC.PLLFRACN=0
RCC.QSPICLockSelection=RCC_QSPICLKSOURCE_D1HCLK
RCC.RC48_VALUE=48000000
RCC.RCC_MCO1Source=RCC_MCO1SOURCE_HSI
RCC.RCC_MCO2Source=RCC_MCO2SOURCE_SYSCLK
RCC.RCC_MCODiv1=RCC_MCODIV_1
RCC.RCC_MCODiv2=RCC_MCODIV_1
RCC.RCC_RTC_Clock_Source_FROM_HSE=RCC_RTCCLKSOURCE_HSE_DIV2
RCC.RNGCLockSelection=RCC_RNGCLKSOURCE_HSI48
RCC.SAI1CLockSelection=RCC_SAI1CLKSOURCE_PLL
RCC.SAI23CLockSelection=RCC_SAI23CLKSOURCE_PLL
RCC.SAI4ACLockSelection=RCC_SAI4ACLKSOURCE_PLL
RCC.SAI4BCLockSelection=RCC_SAI4BCLKSOURCE_PLL
RCC.SPDIFCLockSelection=RCC_SPDIFRXCLKSOURCE_PLL
RCC.SPI123CLockSelection=RCC_SPI123CLKSOURCE_PLL
RCC.SPI6CLockSelection=RCC_SPI6CLKSOURCE_D3PCLK1
RCC.SWPCLockSelection=RCC_SWPMI1CLKSOURCE_D2PCLK1
RCC.SYSCLKFreq_VALUE=480000000
RCC.SYSCLKSource=RCC_SYSCLKSOURCE_PLLCLK
RCC.Spi45ClockSelection=RCC_SPI45CLKSOURCE_D2PCLK1
RCC.USART16CLockSelection=RCC_USART16CLKSOURCE_D2PCLK2
RCC.USART234578CLockSelection=RCC_USART234578CLKSOURCE_D2PCLK1
RCC.USBCLockSelection=RCC_USBCLKSOURCE_HSI48
RCC.USBFreq_Value=48000000
SH.S_TIM1_CH1.0=TIM1_CH1,Encoder_Interface
SH.S_TIM1_CH2.0=TIM1_CH2,Encoder_Interface
SH.S_TIM2_CH1_ETR.0=TIM2_CH1,Encoder_Interface
SH.S_TIM2_CH2.0=TIM2_CH2,Encoder_Interface
SH.S_TIM3_CH1.0=TIM3_CH1,Encoder_Interface
SH.S_TIM3_CH2.0=TIM3_CH2,Encoder_Interface
SH.S_TIM4_CH1.0=TIM4_CH1,Encoder_Interface
SH.S_TIM4_CH2.0=TIM4_CH2,Encoder_Interface
SH.S_TIM5_CH1.0=TIM5_CH1,Encoder_Interface
SH.S_TIM5_CH2.0=TIM5_CH2,Encoder_Interface
SH.S_TIM8_CH1.0=TIM8_CH1,Encoder_Interface
SH.S_TIM8_CH2.0=TIM8_CH2,Encoder_Interface
TIM12.Prescaler=400
TIM13.Prescaler=400
TIM14.Prescaler=400
TIM15.Prescaler=400
TIM16.Prescaler=400
TIM17.Prescaler=400
USART1.VirtualMode-Asynchronous=VM_ASYNC
USB_DEVICE.CLASS_NAME_FS=CDC
USB_DEVICE.VirtualMode-CDC_FS=Cdc
USB_DEVICE.VirtualModeFS=Cdc_FS
USB_OTG_FS.VirtualMode=Device_Only
USB_OTG_HS.VirtualMode-Device_Only_FS=Device_Only_FS
USB_OTG_HS.lpm_enable-Device_Only_FS=DISABLE
USB_OTG_HS.use_dedicated_ep1-Device_Only_FS=ENABLE
VP_HRTIM_VS_hrtimTimerANoOutput.Mode=No_output_TA
VP_MEMORYMAP_VS_MEMORYMAP.Mode=CurAppReg
VP_TIM12_VS_ClockSourceINT.Mode=Internal
VP_TIM13_VS_ClockSourceINT.Mode=Enable_Timer
VP_TIM14_VS_ClockSourceINT.Mode=Enable_Timer
VP_TIM15_VS_ClockSourceINT.Mode=Internal
VP_TIM16_VS_ClockSourceINT.Mode=Enable_Timer
VP_TIM17_VS_ClockSourceINT.Mode=Enable_Timer
VP_USB_DEVICE_VS_USB_DEVICE_CDC_FS.Mode=CDC_FS
board=custom

// file: Core/Src/main.c
/* USER CODE BEGIN Header */
/**
  ******************************************************************************
  * @file           : main.c
  * @brief          : Main program body
  ******************************************************************************
  * @attention
  *
  * Copyright (c) 2025 STMicroelectronics.
  * All rights reserved.
  *
  * This software is licensed under terms that can be found in the LICENSE file
  * in the root directory of this software component.
  * If no LICENSE file comes with this software, it is provided AS-IS.
  *
  ******************************************************************************
  */
/* USER CODE END Header */
#include "main.h"
#include "usb_device.h"

/* USER CODE BEGIN Includes */
#include "usart1.h"
#include "usb_fs.h"
#include "peer_exchange.h"
#include "app.h"
#include "timer.h"
#include "stepper.h"
#include "position_detector.h"
/* USER CODE END Includes */

HRTIM_HandleTypeDef hhrtim;

LPTIM_HandleTypeDef hlptim1;
LPTIM_HandleTypeDef hlptim2;

TIM_HandleTypeDef htim1;
TIM_HandleTypeDef htim2;
TIM_HandleTypeDef htim3;
TIM_HandleTypeDef htim4;
TIM_HandleTypeDef htim5;
TIM_HandleTypeDef htim8;
TIM_HandleTypeDef htim12;
TIM_HandleTypeDef htim13;
TIM_HandleTypeDef htim14;
TIM_HandleTypeDef htim15;
TIM_HandleTypeDef htim16;
TIM_HandleTypeDef htim17;

UART_HandleTypeDef huart1;

PCD_HandleTypeDef hpcd_USB_OTG_HS;

/* USER CODE BEGIN PV */

uint32_t mainLoopCount;

/* USER CODE END PV */

void SystemClock_Config(void);
static void MPU_Config(void);
static void MX_GPIO_Init(void);
static void MX_LPTIM1_Init(void);
static void MX_LPTIM2_Init(void);
static void MX_TIM1_Init(void);
static void MX_TIM2_Init(void);
static void MX_TIM3_Init(void);
static void MX_TIM4_Init(void);
static void MX_TIM5_Init(void);
static void MX_TIM8_Init(void);
static void MX_TIM12_Init(void);
static void MX_TIM13_Init(void);
static void MX_TIM14_Init(void);
static void MX_TIM15_Init(void);
static void MX_TIM16_Init(void);
static void MX_TIM17_Init(void);
static void MX_USART1_UART_Init(void);
static void MX_USB_OTG_HS_PCD_Init(void);
static void MX_HRTIM_Init(void);

/* USER CODE BEGIN 0 */

static inline bool wrapper_send_bytes_to_peer(const uint8_t * p_buffer, const uint16_t length)
{
	return send_usb_fs_bytes(p_buffer, length);
}

static inline uint16_t wrapper_get_timestamp_ms(void)
{
	return HAL_GetTick();
}

/* USER CODE END 0 */

int main(void)
{

  /* MPU Configuration--------------------------------------------------------*/
  MPU_Config();

  /* MCU Configuration--------------------------------------------------------*/

  /* Reset of all peripherals, Initializes the Flash interface and the Systick. */
  HAL_Init();

  /* USER CODE BEGIN Init */
  prepare_uart1();
  init_usb_fs();
  /* USER CODE END Init */

  /* Configure the system clock */
  SystemClock_Config();

  /* Initialize all configured peripherals */
  MX_GPIO_Init();
  MX_LPTIM1_Init();
  MX_LPTIM2_Init();
  MX_TIM1_Init();
  MX_TIM2_Init();
  MX_TIM3_Init();
  MX_TIM4_Init();
  MX_TIM5_Init();
  MX_TIM8_Init();
  MX_TIM12_Init();
  MX_TIM13_Init();
  MX_TIM14_Init();
  MX_TIM15_Init();
  MX_TIM16_Init();
  MX_TIM17_Init();
  MX_USART1_UART_Init();
  MX_USB_OTG_HS_PCD_Init();
  MX_USB_DEVICE_Init();
  MX_HRTIM_Init();
  /* USER CODE BEGIN 2 */

  print_log("Virtual Operator: %s\r\n", APP_VERSION);

  encoders_init();

  if(!init_peer_exchange(get_usb_fs_byte,
		  wrapper_send_bytes_to_peer,
		  wrapper_get_timestamp_ms,
		  on_host_command))
  {
	    print_log("Error: fail to initialize peer_exchange in %s\r\n", __FILE__);
  }

  if(HAL_OK != HAL_LPTIM_Encoder_Start(&hlptim1, 0xFFFF)) {
	  print_log("Error: failed to start LPTIM1 encoder\r\n");
  } else {
	  print_log("LPTIM1 encoder is started\r\n");
  }

  if(HAL_OK != HAL_LPTIM_Encoder_Start(&hlptim2, 0xFFFF)) {
	  print_log("Error: failed to start LPTIM2 encoder\r\n");
  } else {
	  print_log("LPTIM2 encoder is started\r\n");
  }

  if(HAL_OK != HAL_TIM_Encoder_Start(&htim1, TIM_CHANNEL_ALL)) {
	  print_log("Error: failed to start TIM1 encoder\r\n");
  } else {
	  print_log("TIM1 encoder is started\r\n");
  }

  if(HAL_OK != HAL_TIM_Encoder_Start(&htim2, TIM_CHANNEL_ALL)) {
	  print_log("Error: failed to start TIM2 encoder\r\n");
  } else {
	  print_log("TIM2 encoder is started\r\n");
  }

  if(HAL_OK != HAL_TIM_Encoder_Start(&htim3, TIM_CHANNEL_ALL)) {
	  print_log("Error: failed to start TIM3 encoder\r\n");
  } else {
	  print_log("TIM3 encoder is started\r\n");
  }

  if(HAL_OK != HAL_TIM_Encoder_Start(&htim4, TIM_CHANNEL_ALL)) {
	  print_log("Error: failed to start TIM4 encoder\r\n");
  } else {
	  print_log("TIM4 encoder is started\r\n");
  }

  if(HAL_OK != HAL_TIM_Encoder_Start(&htim5, TIM_CHANNEL_ALL)) {
	  print_log("Error: failed to start TIM5 encoder\r\n");
  } else {
	  print_log("TIM5 encoder is started\r\n");
  }

  if(HAL_OK != HAL_TIM_Encoder_Start(&htim8, TIM_CHANNEL_ALL)) {
	  print_log("Error: failed to start TIM8 encoder\r\n");
  } else {
	  print_log("TIM8 encoder is started\r\n");
  }

  stepper_init_data_structure();
  timer_init_data_structure();
  position_detector_init_data();

  // start fix timer
  timer_start_fix_timer();

  mainLoopCount = 0;
  /* USER CODE END 2 */

  /* Infinite loop */
  while (1)
  {

    /* USER CODE BEGIN 3 */
	  poll_usart1();
	  poll_usb_fs();
	  poll_peer_exchange();
	  poll_app();

    mainLoopCount++;
  }
  /* USER CODE END 3 */
}

void SystemClock_Config(void)
{
  RCC_OscInitTypeDef RCC_OscInitStruct = {0};
  RCC_ClkInitTypeDef RCC_ClkInitStruct = {0};

  /** Supply configuration update enable
  */
  HAL_PWREx_ConfigSupply(PWR_LDO_SUPPLY);

  /** Configure the main internal regulator output voltage
  */
  __HAL_PWR_VOLTAGESCALING_CONFIG(PWR_REGULATOR_VOLTAGE_SCALE0);

  while(!__HAL_PWR_GET_FLAG(PWR_FLAG_VOSRDY)) {}

  /** Initializes the RCC Oscillators according to the specified parameters
  * in the RCC_OscInitTypeDef structure.
  */
  RCC_OscInitStruct.OscillatorType = RCC_OSCILLATORTYPE_HSI48|RCC_OSCILLATORTYPE_HSI;
  RCC_OscInitStruct.HSIState = RCC_HSI_DIV1;
  RCC_OscInitStruct.HSICalibrationValue = RCC_HSICALIBRATION_DEFAULT;
  RCC_OscInitStruct.HSI48State = RCC_HSI48_ON;
  RCC_OscInitStruct.PLL.PLLState = RCC_PLL_ON;
  RCC_OscInitStruct.PLL.PLLSource = RCC_PLLSOURCE_HSI;
  RCC_OscInitStruct.PLL.PLLM = 4;
  RCC_OscInitStruct.PLL.PLLN = 60;
  RCC_OscInitStruct.PLL.PLLP = 2;
  RCC_OscInitStruct.PLL.PLLQ = 3;
  RCC_OscInitStruct.PLL.PLLR = 2;
  RCC_OscInitStruct.PLL.PLLRGE = RCC_PLL1VCIRANGE_3;
  RCC_OscInitStruct.PLL.PLLVCOSEL = RCC_PLL1VCOWIDE;
  RCC_OscInitStruct.PLL.PLLFRACN = 0;
  if (HAL_RCC_OscConfig(&RCC_OscInitStruct) != HAL_OK)
  {
    Error_Handler();
  }

  /** Initializes the CPU, AHB and APB buses clocks
  */
  RCC_ClkInitStruct.ClockType = RCC_CLOCKTYPE_HCLK|RCC_CLOCKTYPE_SYSCLK
                              |RCC_CLOCKTYPE_PCLK1|RCC_CLOCKTYPE_PCLK2
                              |RCC_CLOCKTYPE_D3PCLK1|RCC_CLOCKTYPE_D1PCLK1;
  RCC_ClkInitStruct.SYSCLKSource = RCC_SYSCLKSOURCE_PLLCLK;
  RCC_ClkInitStruct.SYSCLKDivider = RCC_SYSCLK_DIV1;
  RCC_ClkInitStruct.AHBCLKDivider = RCC_HCLK_DIV2;
  RCC_ClkInitStruct.APB3CLKDivider = RCC_APB3_DIV2;
  RCC_ClkInitStruct.APB1CLKDivider = RCC_APB1_DIV2;
  RCC_ClkInitStruct.APB2CLKDivider = RCC_APB2_DIV2;
  RCC_ClkInitStruct.APB4CLKDivider = RCC_APB4_DIV2;

  if (HAL_RCC_ClockConfig(&RCC_ClkInitStruct, FLASH_LATENCY_4) != HAL_OK)
  {
    Error_Handler();
  }
  HAL_RCC_MCOConfig(RCC_MCO1, RCC_MCO1SOURCE_HSI, RCC_MCODIV_1);
}

static void MX_HRTIM_Init(void)
{

  HRTIM_TimeBaseCfgTypeDef pTimeBaseCfg = {0};
  HRTIM_TimerCfgTypeDef pTimerCfg = {0};

  hhrtim.Instance = HRTIM1;
  hhrtim.Init.HRTIMInterruptResquests = HRTIM_IT_NONE;
  hhrtim.Init.SyncOptions = HRTIM_SYNCOPTION_NONE;
  if (HAL_HRTIM_Init(&hhrtim) != HAL_OK)
  {
    Error_Handler();
  }
  pTimeBaseCfg.Period = 0x7000;
  pTimeBaseCfg.RepetitionCounter = 0x00;
  pTimeBaseCfg.PrescalerRatio = HRTIM_PRESCALERRATIO_DIV4;
  pTimeBaseCfg.Mode = HRTIM_MODE_CONTINUOUS;
  if (HAL_HRTIM_TimeBaseConfig(&hhrtim, HRTIM_TIMERINDEX_TIMER_A, &pTimeBaseCfg) != HAL_OK)
  {
    Error_Handler();
  }
  pTimerCfg.InterruptRequests = HRTIM_TIM_IT_NONE;
  pTimerCfg.DMARequests = HRTIM_TIM_DMA_NONE;
  pTimerCfg.DMASrcAddress = 0x0000;
  pTimerCfg.DMADstAddress = 0x0000;
  pTimerCfg.DMASize = 0x1;
  pTimerCfg.HalfModeEnable = HRTIM_HALFMODE_DISABLED;
  pTimerCfg.StartOnSync = HRTIM_SYNCSTART_DISABLED;
  pTimerCfg.ResetOnSync = HRTIM_SYNCRESET_DISABLED;
  pTimerCfg.DACSynchro = HRTIM_DACSYNC_NONE;
  pTimerCfg.PreloadEnable = HRTIM_PRELOAD_DISABLED;
  pTimerCfg.UpdateGating = HRTIM_UPDATEGATING_INDEPENDENT;
  pTimerCfg.BurstMode = HRTIM_TIMERBURSTMODE_MAINTAINCLOCK;
  pTimerCfg.RepetitionUpdate = HRTIM_UPDATEONREPETITION_DISABLED;
  pTimerCfg.PushPull = HRTIM_TIMPUSHPULLMODE_DISABLED;
  pTimerCfg.FaultEnable = HRTIM_TIMFAULTENABLE_NONE;
  pTimerCfg.FaultLock = HRTIM_TIMFAULTLOCK_READWRITE;
  pTimerCfg.DeadTimeInsertion = HRTIM_TIMDEADTIMEINSERTION_DISABLED;
  pTimerCfg.DelayedProtectionMode = HRTIM_TIMER_A_B_C_DELAYEDPROTECTION_DISABLED;
  pTimerCfg.UpdateTrigger = HRTIM_TIMUPDATETRIGGER_NONE;
  pTimerCfg.ResetTrigger = HRTIM_TIMRESETTRIGGER_NONE;
  pTimerCfg.ResetUpdate = HRTIM_TIMUPDATEONRESET_DISABLED;
  if (HAL_HRTIM_WaveformTimerConfig(&hhrtim, HRTIM_TIMERINDEX_TIMER_A, &pTimerCfg) != HAL_OK)
  {
    Error_Handler();
  }

}

static void MX_LPTIM1_Init(void)
{

  hlptim1.Instance = LPTIM1;
  hlptim1.Init.Clock.Source = LPTIM_CLOCKSOURCE_APBCLOCK_LPOSC;
  hlptim1.Init.Clock.Prescaler = LPTIM_PRESCALER_DIV1;
  hlptim1.Init.UltraLowPowerClock.Polarity = LPTIM_CLOCKPOLARITY_RISING;
  hlptim1.Init.UltraLowPowerClock.SampleTime = LPTIM_CLOCKSAMPLETIME_DIRECTTRANSITION;
  hlptim1.Init.Trigger.Source = LPTIM_TRIGSOURCE_SOFTWARE;
  hlptim1.Init.OutputPolarity = LPTIM_OUTPUTPOLARITY_HIGH;
  hlptim1.Init.UpdateMode = LPTIM_UPDATE_IMMEDIATE;
  hlptim1.Init.CounterSource = LPTIM_COUNTERSOURCE_EXTERNAL;
  hlptim1.Init.Input1Source = LPTIM_INPUT1SOURCE_GPIO;
  hlptim1.Init.Input2Source = LPTIM_INPUT2SOURCE_GPIO;
  if (HAL_LPTIM_Init(&hlptim1) != HAL_OK)
  {
    Error_Handler();
  }

}

static void MX_LPTIM2_Init(void)
{

  hlptim2.Instance = LPTIM2;
  hlptim2.Init.Clock.Source = LPTIM_CLOCKSOURCE_APBCLOCK_LPOSC;
  hlptim2.Init.Clock.Prescaler = LPTIM_PRESCALER_DIV1;
  hlptim2.Init.UltraLowPowerClock.Polarity = LPTIM_CLOCKPOLARITY_RISING;
  hlptim2.Init.UltraLowPowerClock.SampleTime = LPTIM_CLOCKSAMPLETIME_DIRECTTRANSITION;
  hlptim2.Init.Trigger.Source = LPTIM_TRIGSOURCE_SOFTWARE;
  hlptim2.Init.OutputPolarity = LPTIM_OUTPUTPOLARITY_HIGH;
  hlptim2.Init.UpdateMode = LPTIM_UPDATE_IMMEDIATE;
  hlptim2.Init.CounterSource = LPTIM_COUNTERSOURCE_EXTERNAL;
  hlptim2.Init.Input1Source = LPTIM_INPUT1SOURCE_GPIO;
  hlptim2.Init.Input2Source = LPTIM_INPUT2SOURCE_GPIO;
  if (HAL_LPTIM_Init(&hlptim2) != HAL_OK)
  {
    Error_Handler();
  }

}

static void MX_TIM1_Init(void)
{

  TIM_Encoder_InitTypeDef sConfig = {0};
  TIM_MasterConfigTypeDef sMasterConfig = {0};

  htim1.Instance = TIM1;
  htim1.Init.Prescaler = 0;
  htim1.Init.CounterMode = TIM_COUNTERMODE_UP;
  htim1.Init.Period = 65535;
  htim1.Init.ClockDivision = TIM_CLOCKDIVISION_DIV1;
  htim1.Init.RepetitionCounter = 0;
  htim1.Init.AutoReloadPreload = TIM_AUTORELOAD_PRELOAD_DISABLE;
  sConfig.EncoderMode = TIM_ENCODERMODE_TI1;
  sConfig.IC1Polarity = TIM_ICPOLARITY_RISING;
  sConfig.IC1Selection = TIM_ICSELECTION_DIRECTTI;
  sConfig.IC1Prescaler = TIM_ICPSC_DIV1;
  sConfig.IC1Filter = 0;
  sConfig.IC2Polarity = TIM_ICPOLARITY_RISING;
  sConfig.IC2Selection = TIM_ICSELECTION_DIRECTTI;
  sConfig.IC2Prescaler = TIM_ICPSC_DIV1;
  sConfig.IC2Filter = 0;
  if (HAL_TIM_Encoder_Init(&htim1, &sConfig) != HAL_OK)
  {
    Error_Handler();
  }
  sMasterConfig.MasterOutputTrigger = TIM_TRGO_RESET;
  sMasterConfig.MasterOutputTrigger2 = TIM_TRGO2_RESET;
  sMasterConfig.MasterSlaveMode = TIM_MASTERSLAVEMODE_DISABLE;
  if (HAL_TIMEx_MasterConfigSynchronization(&htim1, &sMasterConfig) != HAL_OK)
  {
    Error_Handler();
  }

}

static void MX_TIM2_Init(void)
{

  TIM_Encoder_InitTypeDef sConfig = {0};
  TIM_MasterConfigTypeDef sMasterConfig = {0};

  htim2.Instance = TIM2;
  htim2.Init.Prescaler = 0;
  htim2.Init.CounterMode = TIM_COUNTERMODE_UP;
  htim2.Init.Period = 4294967295;
  htim2.Init.ClockDivision = TIM_CLOCKDIVISION_DIV1;
  htim2.Init.AutoReloadPreload = TIM_AUTORELOAD_PRELOAD_DISABLE;
  sConfig.EncoderMode = TIM_ENCODERMODE_TI1;
  sConfig.IC1Polarity = TIM_ICPOLARITY_RISING;
  sConfig.IC1Selection = TIM_ICSELECTION_DIRECTTI;
  sConfig.IC1Prescaler = TIM_ICPSC_DIV1;
  sConfig.IC1Filter = 0;
  sConfig.IC2Polarity = TIM_ICPOLARITY_RISING;
  sConfig.IC2Selection = TIM_ICSELECTION_DIRECTTI;
  sConfig.IC2Prescaler = TIM_ICPSC_DIV1;
  sConfig.IC2Filter = 0;
  if (HAL_TIM_Encoder_Init(&htim2, &sConfig) != HAL_OK)
  {
    Error_Handler();
  }
  sMasterConfig.MasterOutputTrigger = TIM_TRGO_RESET;
  sMasterConfig.MasterSlaveMode = TIM_MASTERSLAVEMODE_DISABLE;
  if (HAL_TIMEx_MasterConfigSynchronization(&htim2, &sMasterConfig) != HAL_OK)
  {
    Error_Handler();
  }

}

static void MX_TIM3_Init(void)
{

  TIM_Encoder_InitTypeDef sConfig = {0};
  TIM_MasterConfigTypeDef sMasterConfig = {0};

  htim3.Instance = TIM3;
  htim3.Init.Prescaler = 0;
  htim3.Init.CounterMode = TIM_COUNTERMODE_UP;
  htim3.Init.Period = 65535;
  htim3.Init.ClockDivision = TIM_CLOCKDIVISION_DIV1;
  htim3.Init.AutoReloadPreload = TIM_AUTORELOAD_PRELOAD_DISABLE;
  sConfig.EncoderMode = TIM_ENCODERMODE_TI1;
  sConfig.IC1Polarity = TIM_ICPOLARITY_RISING;
  sConfig.IC1Selection = TIM_ICSELECTION_DIRECTTI;
  sConfig.IC1Prescaler = TIM_ICPSC_DIV1;
  sConfig.IC1Filter = 0;
  sConfig.IC2Polarity = TIM_ICPOLARITY_RISING;
  sConfig.IC2Selection = TIM_ICSELECTION_DIRECTTI;
  sConfig.IC2Prescaler = TIM_ICPSC_DIV1;
  sConfig.IC2Filter = 0;
  if (HAL_TIM_Encoder_Init(&htim3, &sConfig) != HAL_OK)
  {
    Error_Handler();
  }
  sMasterConfig.MasterOutputTrigger = TIM_TRGO_RESET;
  sMasterConfig.MasterSlaveMode = TIM_MASTERSLAVEMODE_DISABLE;
  if (HAL_TIMEx_MasterConfigSynchronization(&htim3, &sMasterConfig) != HAL_OK)
  {
    Error_Handler();
  }

}

static void MX_TIM4_Init(void)
{

  TIM_Encoder_InitTypeDef sConfig = {0};
  TIM_MasterConfigTypeDef sMasterConfig = {0};

  htim4.Instance = TIM4;
  htim4.Init.Prescaler = 0;
  htim4.Init.CounterMode = TIM_COUNTERMODE_UP;
  htim4.Init.Period = 65535;
  htim4.Init.ClockDivision = TIM_CLOCKDIVISION_DIV1;
  htim4.Init.AutoReloadPreload = TIM_AUTORELOAD_PRELOAD_DISABLE;
  sConfig.EncoderMode = TIM_ENCODERMODE_TI1;
  sConfig.IC1Polarity = TIM_ICPOLARITY_RISING;
  sConfig.IC1Selection = TIM_ICSELECTION_DIRECTTI;
  sConfig.IC1Prescaler = TIM_ICPSC_DIV1;
  sConfig.IC1Filter = 0;
  sConfig.IC2Polarity = TIM_ICPOLARITY_RISING;
  sConfig.IC2Selection = TIM_ICSELECTION_DIRECTTI;
  sConfig.IC2Prescaler = TIM_ICPSC_DIV1;
  sConfig.IC2Filter = 0;
  if (HAL_TIM_Encoder_Init(&htim4, &sConfig) != HAL_OK)
  {
    Error_Handler();
  }
  sMasterConfig.MasterOutputTrigger = TIM_TRGO_RESET;
  sMasterConfig.MasterSlaveMode = TIM_MASTERSLAVEMODE_DISABLE;
  if (HAL_TIMEx_MasterConfigSynchronization(&htim4, &sMasterConfig) != HAL_OK)
  {
    Error_Handler();
  }

}

static void MX_TIM5_Init(void)
{

  TIM_Encoder_InitTypeDef sConfig = {0};
  TIM_MasterConfigTypeDef sMasterConfig = {0};

  htim5.Instance = TIM5;
  htim5.Init.Prescaler = 0;
  htim5.Init.CounterMode = TIM_COUNTERMODE_UP;
  htim5.Init.Period = 4294967295;
  htim5.Init.ClockDivision = TIM_CLOCKDIVISION_DIV1;
  htim5.Init.AutoReloadPreload = TIM_AUTORELOAD_PRELOAD_DISABLE;
  sConfig.EncoderMode = TIM_ENCODERMODE_TI1;
  sConfig.IC1Polarity = TIM_ICPOLARITY_RISING;
  sConfig.IC1Selection = TIM_ICSELECTION_DIRECTTI;
  sConfig.IC1Prescaler = TIM_ICPSC_DIV1;
  sConfig.IC1Filter = 0;
  sConfig.IC2Polarity = TIM_ICPOLARITY_RISING;
  sConfig.IC2Selection = TIM_ICSELECTION_DIRECTTI;
  sConfig.IC2Prescaler = TIM_ICPSC_DIV1;
  sConfig.IC2Filter = 0;
  if (HAL_TIM_Encoder_Init(&htim5, &sConfig) != HAL_OK)
  {
    Error_Handler();
  }
  sMasterConfig.MasterOutputTrigger = TIM_TRGO_RESET;
  sMasterConfig.MasterSlaveMode = TIM_MASTERSLAVEMODE_DISABLE;
  if (HAL_TIMEx_MasterConfigSynchronization(&htim5, &sMasterConfig) != HAL_OK)
  {
    Error_Handler();
  }

}

static void MX_TIM8_Init(void)
{

  TIM_Encoder_InitTypeDef sConfig = {0};
  TIM_MasterConfigTypeDef sMasterConfig = {0};

  htim8.Instance = TIM8;
  htim8.Init.Prescaler = 0;
  htim8.Init.CounterMode = TIM_COUNTERMODE_UP;
  htim8.Init.Period = 65535;
  htim8.Init.ClockDivision = TIM_CLOCKDIVISION_DIV1;
  htim8.Init.RepetitionCounter = 0;
  htim8.Init.AutoReloadPreload = TIM_AUTORELOAD_PRELOAD_DISABLE;
  sConfig.EncoderMode = TIM_ENCODERMODE_TI1;
  sConfig.IC1Polarity = TIM_ICPOLARITY_RISING;
  sConfig.IC1Selection = TIM_ICSELECTION_DIRECTTI;
  sConfig.IC1Prescaler = TIM_ICPSC_DIV1;
  sConfig.IC1Filter = 0;
  sConfig.IC2Polarity = TIM_ICPOLARITY_RISING;
  sConfig.IC2Selection = TIM_ICSELECTION_DIRECTTI;
  sConfig.IC2Prescaler = TIM_ICPSC_DIV1;
  sConfig.IC2Filter = 0;
  if (HAL_TIM_Encoder_Init(&htim8, &sConfig) != HAL_OK)
  {
    Error_Handler();
  }
  sMasterConfig.MasterOutputTrigger = TIM_TRGO_RESET;
  sMasterConfig.MasterOutputTrigger2 = TIM_TRGO2_RESET;
  sMasterConfig.MasterSlaveMode = TIM_MASTERSLAVEMODE_DISABLE;
  if (HAL_TIMEx_MasterConfigSynchronization(&htim8, &sMasterConfig) != HAL_OK)
  {
    Error_Handler();
  }

}

static void MX_TIM12_Init(void)
{

  TIM_ClockConfigTypeDef sClockSourceConfig = {0};
  TIM_MasterConfigTypeDef sMasterConfig = {0};

  htim12.Instance = TIM12;
  htim12.Init.Prescaler = 400;
  htim12.Init.CounterMode = TIM_COUNTERMODE_UP;
  htim12.Init.Period = 65535;
  htim12.Init.ClockDivision = TIM_CLOCKDIVISION_DIV1;
  htim12.Init.AutoReloadPreload = TIM_AUTORELOAD_PRELOAD_DISABLE;
  if (HAL_TIM_Base_Init(&htim12) != HAL_OK)
  {
    Error_Handler();
  }
  sClockSourceConfig.ClockSource = TIM_CLOCKSOURCE_INTERNAL;
  if (HAL_TIM_ConfigClockSource(&htim12, &sClockSourceConfig) != HAL_OK)
  {
    Error_Handler();
  }
  sMasterConfig.MasterOutputTrigger = TIM_TRGO_RESET;
  sMasterConfig.MasterSlaveMode = TIM_MASTERSLAVEMODE_DISABLE;
  if (HAL_TIMEx_MasterConfigSynchronization(&htim12, &sMasterConfig) != HAL_OK)
  {
    Error_Handler();
  }

}

static void MX_TIM13_Init(void)
{

  htim13.Instance = TIM13;
  htim13.Init.Prescaler = 400;
  htim13.Init.CounterMode = TIM_COUNTERMODE_UP;
  htim13.Init.Period = 65535;
  htim13.Init.ClockDivision = TIM_CLOCKDIVISION_DIV1;
  htim13.Init.AutoReloadPreload = TIM_AUTORELOAD_PRELOAD_DISABLE;
  if (HAL_TIM_Base_Init(&htim13) != HAL_OK)
  {
    Error_Handler();
  }

}

static void MX_TIM14_Init(void)
{

  htim14.Instance = TIM14;
  htim14.Init.Prescaler = 400;
  htim14.Init.CounterMode = TIM_COUNTERMODE_UP;
  htim14.Init.Period = 65535;
  htim14.Init.ClockDivision = TIM_CLOCKDIVISION_DIV1;
  htim14.Init.AutoReloadPreload = TIM_AUTORELOAD_PRELOAD_DISABLE;
  if (HAL_TIM_Base_Init(&htim14) != HAL_OK)
  {
    Error_Handler();
  }

}

static void MX_TIM15_Init(void)
{

  TIM_ClockConfigTypeDef sClockSourceConfig = {0};
  TIM_MasterConfigTypeDef sMasterConfig = {0};

  htim15.Instance = TIM15;
  htim15.Init.Prescaler = 400;
  htim15.Init.CounterMode = TIM_COUNTERMODE_UP;
  htim15.Init.Period = 65535;
  htim15.Init.ClockDivision = TIM_CLOCKDIVISION_DIV1;
  htim15.Init.RepetitionCounter = 0;
  htim15.Init.AutoReloadPreload = TIM_AUTORELOAD_PRELOAD_DISABLE;
  if (HAL_TIM_Base_Init(&htim15) != HAL_OK)
  {
    Error_Handler();
  }
  sClockSourceConfig.ClockSource = TIM_CLOCKSOURCE_INTERNAL;
  if (HAL_TIM_ConfigClockSource(&htim15, &sClockSourceConfig) != HAL_OK)
  {
    Error_Handler();
  }
  sMasterConfig.MasterOutputTrigger = TIM_TRGO_RESET;
  sMasterConfig.MasterSlaveMode = TIM_MASTERSLAVEMODE_DISABLE;
  if (HAL_TIMEx_MasterConfigSynchronization(&htim15, &sMasterConfig) != HAL_OK)
  {
    Error_Handler();
  }

}

static void MX_TIM16_Init(void)
{

  htim16.Instance = TIM16;
  htim16.Init.Prescaler = 400;
  htim16.Init.CounterMode = TIM_COUNTERMODE_UP;
  htim16.Init.Period = 65535;
  htim16.Init.ClockDivision = TIM_CLOCKDIVISION_DIV1;
  htim16.Init.RepetitionCounter = 0;
  htim16.Init.AutoReloadPreload = TIM_AUTORELOAD_PRELOAD_DISABLE;
  if (HAL_TIM_Base_Init(&htim16) != HAL_OK)
  {
    Error_Handler();
  }

}

static void MX_TIM17_Init(void)
{

  htim17.Instance = TIM17;
  htim17.Init.Prescaler = 400;
  htim17.Init.CounterMode = TIM_COUNTERMODE_UP;
  htim17.Init.Period = 65535;
  htim17.Init.ClockDivision = TIM_CLOCKDIVISION_DIV1;
  htim17.Init.RepetitionCounter = 0;
  htim17.Init.AutoReloadPreload = TIM_AUTORELOAD_PRELOAD_DISABLE;
  if (HAL_TIM_Base_Init(&htim17) != HAL_OK)
  {
    Error_Handler();
  }

}

static void MX_USART1_UART_Init(void)
{

  huart1.Instance = USART1;
  huart1.Init.BaudRate = 115200;
  huart1.Init.WordLength = UART_WORDLENGTH_8B;
  huart1.Init.StopBits = UART_STOPBITS_1;
  huart1.Init.Parity = UART_PARITY_NONE;
  huart1.Init.Mode = UART_MODE_TX_RX;
  huart1.Init.HwFlowCtl = UART_HWCONTROL_NONE;
  huart1.Init.OverSampling = UART_OVERSAMPLING_16;
  huart1.Init.OneBitSampling = UART_ONE_BIT_SAMPLE_DISABLE;
  huart1.Init.ClockPrescaler = UART_PRESCALER_DIV1;
  huart1.AdvancedInit.AdvFeatureInit = UART_ADVFEATURE_NO_INIT;
  if (HAL_UART_Init(&huart1) != HAL_OK)
  {
    Error_Handler();
  }
  if (HAL_UARTEx_SetTxFifoThreshold(&huart1, UART_TXFIFO_THRESHOLD_1_8) != HAL_OK)
  {
    Error_Handler();
  }
  if (HAL_UARTEx_SetRxFifoThreshold(&huart1, UART_RXFIFO_THRESHOLD_1_8) != HAL_OK)
  {
    Error_Handler();
  }
  if (HAL_UARTEx_DisableFifoMode(&huart1) != HAL_OK)
  {
    Error_Handler();
  }

}

static void MX_USB_OTG_HS_PCD_Init(void)
{

  hpcd_USB_OTG_HS.Instance = USB_OTG_HS;
  hpcd_USB_OTG_HS.Init.dev_endpoints = 9;
  hpcd_USB_OTG_HS.Init.speed = PCD_SPEED_FULL;
  hpcd_USB_OTG_HS.Init.dma_enable = DISABLE;
  hpcd_USB_OTG_HS.Init.phy_itface = USB_OTG_EMBEDDED_PHY;
  hpcd_USB_OTG_HS.Init.Sof_enable = DISABLE;
  hpcd_USB_OTG_HS.Init.low_power_enable = DISABLE;
  hpcd_USB_OTG_HS.Init.lpm_enable = DISABLE;
  hpcd_USB_OTG_HS.Init.vbus_sensing_enable = DISABLE;
  hpcd_USB_OTG_HS.Init.use_dedicated_ep1 = ENABLE;
  hpcd_USB_OTG_HS.Init.use_external_vbus = DISABLE;
  if (HAL_PCD_Init(&hpcd_USB_OTG_HS) != HAL_OK)
  {
    Error_Handler();
  }

}

static void MX_GPIO_Init(void)
{
  GPIO_InitTypeDef GPIO_InitStruct = {0};

  /* GPIO Ports Clock Enable */
  __HAL_RCC_GPIOE_CLK_ENABLE();
  __HAL_RCC_GPIOI_CLK_ENABLE();
  __HAL_RCC_GPIOC_CLK_ENABLE();
  __HAL_RCC_GPIOF_CLK_ENABLE();
  __HAL_RCC_GPIOH_CLK_ENABLE();
  __HAL_RCC_GPIOA_CLK_ENABLE();
  __HAL_RCC_GPIOB_CLK_ENABLE();
  __HAL_RCC_GPIOJ_CLK_ENABLE();
  __HAL_RCC_GPIOG_CLK_ENABLE();
  __HAL_RCC_GPIOD_CLK_ENABLE();
  __HAL_RCC_GPIOK_CLK_ENABLE();

  /*Configure GPIO pin Output Level */
  HAL_GPIO_WritePin(GPIOE, GP1_out_Pin|GP2_out_Pin|CLK_STP0_Pin|GP3_out_Pin
                          |GP113_out_Pin|GP114_out_Pin, GPIO_PIN_RESET);

  /*Configure GPIO pin Output Level */
  HAL_GPIO_WritePin(GPIOC, GP5_out_Pin|GP7_out_Pin|GP84_out_Pin, GPIO_PIN_RESET);

  /*Configure GPIO pin Output Level */
  HAL_GPIO_WritePin(GPIOI, GP8_out_Pin|GP79_out_Pin|GP82_out_Pin|GP115_out_Pin
                          |GP118_out_Pin, GPIO_PIN_RESET);

  /*Configure GPIO pin Output Level */
  HAL_GPIO_WritePin(GPIOF, CLK_STP1_Pin|CLK_STP2_Pin, GPIO_PIN_RESET);

  /*Configure GPIO pin Output Level */
  HAL_GPIO_WritePin(GPIOA, CLK_STP3_Pin|CLK_STP4_Pin, GPIO_PIN_RESET);

  /*Configure GPIO pin Output Level */
  HAL_GPIO_WritePin(GPIOJ, GP52_out_Pin|GP61_out_Pin|GP62_out_Pin|GP63_out_Pin
                          |GP64_out_Pin|GP96_out_Pin, GPIO_PIN_RESET);

  /*Configure GPIO pin Output Level */
  HAL_GPIO_WritePin(GPIOH, CLK_STP5_Pin|GP53_out_Pin|GP54_out_Pin|GP55_out_Pin
                          |GP56_out_Pin|GP78_out_Pin, GPIO_PIN_RESET);

  /*Configure GPIO pin Output Level */
  HAL_GPIO_WritePin(GPIOD, USB_DEC_1_out_Pin|GP57_out_Pin|GP58_out_Pin|GP59_out_Pin
                          |GP60_out_Pin, GPIO_PIN_RESET);

  /*Configure GPIO pin Output Level */
  HAL_GPIO_WritePin(GPIOK, GP65_out_Pin|GP66_out_Pin|GP67_out_Pin|GP104_out_Pin
                          |GP107_out_Pin, GPIO_PIN_RESET);

  /*Configure GPIO pin Output Level */
  HAL_GPIO_WritePin(GPIOG, GP68_out_Pin|GP69_out_Pin|GP70_out_Pin|GP71_out_Pin
                          |GP72_out_Pin|GP73_out_Pin|GP74_out_Pin|GP98_out_Pin, GPIO_PIN_RESET);

  /*Configure GPIO pin Output Level */
  HAL_GPIO_WritePin(GP112_out_GPIO_Port, GP112_out_Pin, GPIO_PIN_RESET);

  /*Configure GPIO pins : GP0_in_Pin GP45_in_Pin GP46_in_Pin GP47_in_Pin
                           GP48_in_Pin GP49_in_Pin GP50_in_Pin GP51_in_Pin */
  GPIO_InitStruct.Pin = GP0_in_Pin|GP45_in_Pin|GP46_in_Pin|GP47_in_Pin
                          |GP48_in_Pin|GP49_in_Pin|GP50_in_Pin|GP51_in_Pin;
  GPIO_InitStruct.Mode = GPIO_MODE_INPUT;
  GPIO_InitStruct.Pull = GPIO_NOPULL;
  HAL_GPIO_Init(GPIOE, &GPIO_InitStruct);

  /*Configure GPIO pins : GP1_out_Pin GP2_out_Pin CLK_STP0_Pin GP3_out_Pin
                           GP113_out_Pin GP114_out_Pin */
  GPIO_InitStruct.Pin = GP1_out_Pin|GP2_out_Pin|CLK_STP0_Pin|GP3_out_Pin
                          |GP113_out_Pin|GP114_out_Pin;
  GPIO_InitStruct.Mode = GPIO_MODE_OUTPUT_PP;
  GPIO_InitStruct.Pull = GPIO_NOPULL;
  GPIO_InitStruct.Speed = GPIO_SPEED_FREQ_LOW;
  HAL_GPIO_Init(GPIOE, &GPIO_InitStruct);

  /*Configure GPIO pins : GP4_in_Pin GP9_in_Pin GP13_in_Pin GP14_in_Pin
                           GP15_in_Pin GP32_inI15_Pin GP80_in_Pin GP81_in_Pin
                           GP116_in_Pin GP117_in_Pin */
  GPIO_InitStruct.Pin = GP4_in_Pin|GP9_in_Pin|GP13_in_Pin|GP14_in_Pin
                          |GP15_in_Pin|GP32_inI15_Pin|GP80_in_Pin|GP81_in_Pin
                          |GP116_in_Pin|GP117_in_Pin;
  GPIO_InitStruct.Mode = GPIO_MODE_INPUT;
  GPIO_InitStruct.Pull = GPIO_NOPULL;
  HAL_GPIO_Init(GPIOI, &GPIO_InitStruct);

  /*Configure GPIO pins : GP5_out_Pin GP7_out_Pin GP84_out_Pin */
  GPIO_InitStruct.Pin = GP5_out_Pin|GP7_out_Pin|GP84_out_Pin;
  GPIO_InitStruct.Mode = GPIO_MODE_OUTPUT_PP;
  GPIO_InitStruct.Pull = GPIO_NOPULL;
  GPIO_InitStruct.Speed = GPIO_SPEED_FREQ_LOW;
  HAL_GPIO_Init(GPIOC, &GPIO_InitStruct);

  /*Configure GPIO pins : GP6_in_Pin GP22_in_Pin GP23_in_Pin GP29_in_Pin
                           GP30_in_Pin GP75_in_Pin GP76_in_Pin GP83_in_Pin
                           GP85_in_Pin */
  GPIO_InitStruct.Pin = GP6_in_Pin|GP22_in_Pin|GP23_in_Pin|GP29_in_Pin
                          |GP30_in_Pin|GP75_in_Pin|GP76_in_Pin|GP83_in_Pin
                          |GP85_in_Pin;
  GPIO_InitStruct.Mode = GPIO_MODE_INPUT;
  GPIO_InitStruct.Pull = GPIO_NOPULL;
  HAL_GPIO_Init(GPIOC, &GPIO_InitStruct);

  /*Configure GPIO pins : GP8_out_Pin GP79_out_Pin GP82_out_Pin GP115_out_Pin
                           GP118_out_Pin */
  GPIO_InitStruct.Pin = GP8_out_Pin|GP79_out_Pin|GP82_out_Pin|GP115_out_Pin
                          |GP118_out_Pin;
  GPIO_InitStruct.Mode = GPIO_MODE_OUTPUT_PP;
  GPIO_InitStruct.Pull = GPIO_NOPULL;
  GPIO_InitStruct.Speed = GPIO_SPEED_FREQ_LOW;
  HAL_GPIO_Init(GPIOI, &GPIO_InitStruct);

  /*Configure GPIO pins : GP10_in_Pin GP11_in_Pin GP12_in_Pin GP16_in_Pin
                           GP71_in_Pin GP18_in_Pin GP19_in_Pin GP20_in_Pin
                           GP21_in_Pin GP38_in_Pin GP39_in_Pin GP40_in_Pin
                           GP41_in_Pin GP42_in_Pin */
  GPIO_InitStruct.Pin = GP10_in_Pin|GP11_in_Pin|GP12_in_Pin|GP16_in_Pin
                          |GP71_in_Pin|GP18_in_Pin|GP19_in_Pin|GP20_in_Pin
                          |GP21_in_Pin|GP38_in_Pin|GP39_in_Pin|GP40_in_Pin
                          |GP41_in_Pin|GP42_in_Pin;
  GPIO_InitStruct.Mode = GPIO_MODE_INPUT;
  GPIO_InitStruct.Pull = GPIO_NOPULL;
  HAL_GPIO_Init(GPIOF, &GPIO_InitStruct);

  /*Configure GPIO pins : CLK_STP1_Pin CLK_STP2_Pin */
  GPIO_InitStruct.Pin = CLK_STP1_Pin|CLK_STP2_Pin;
  GPIO_InitStruct.Mode = GPIO_MODE_OUTPUT_PP;
  GPIO_InitStruct.Pull = GPIO_NOPULL;
  GPIO_InitStruct.Speed = GPIO_SPEED_FREQ_LOW;
  HAL_GPIO_Init(GPIOF, &GPIO_InitStruct);

  /*Configure GPIO pins : GP24_in_Pin GP28_in_Pin */
  GPIO_InitStruct.Pin = GP24_in_Pin|GP28_in_Pin;
  GPIO_InitStruct.Mode = GPIO_MODE_INPUT;
  GPIO_InitStruct.Pull = GPIO_NOPULL;
  HAL_GPIO_Init(GPIOA, &GPIO_InitStruct);

  /*Configure GPIO pins : GP25_in_Pin GP26_in_Pin GP27_in_Pin USB_DEC_0_in_Pin
                           GP77_in_Pin */
  GPIO_InitStruct.Pin = GP25_in_Pin|GP26_in_Pin|GP27_in_Pin|USB_DEC_0_in_Pin
                          |GP77_in_Pin;
  GPIO_InitStruct.Mode = GPIO_MODE_INPUT;
  GPIO_InitStruct.Pull = GPIO_NOPULL;
  HAL_GPIO_Init(GPIOH, &GPIO_InitStruct);

  /*Configure GPIO pins : CLK_STP3_Pin CLK_STP4_Pin */
  GPIO_InitStruct.Pin = CLK_STP3_Pin|CLK_STP4_Pin;
  GPIO_InitStruct.Mode = GPIO_MODE_OUTPUT_PP;
  GPIO_InitStruct.Pull = GPIO_NOPULL;
  GPIO_InitStruct.Speed = GPIO_SPEED_FREQ_LOW;
  HAL_GPIO_Init(GPIOA, &GPIO_InitStruct);

  /*Configure GPIO pins : GP32_in_Pin GP109_in_Pin GP110_in_Pin GP111_in_Pin */
  GPIO_InitStruct.Pin = GP32_in_Pin|GP109_in_Pin|GP110_in_Pin|GP111_in_Pin;
  GPIO_InitStruct.Mode = GPIO_MODE_INPUT;
  GPIO_InitStruct.Pull = GPIO_NOPULL;
  HAL_GPIO_Init(GPIOB, &GPIO_InitStruct);

  /*Configure GPIO pins : GP33_in_Pin GP34_in_Pin GP35_in_Pin GP36_in_Pin
                           GP37_in_Pin GP94_in_Pin GP95_in_Pin GP97_in_Pin */
  GPIO_InitStruct.Pin = GP33_in_Pin|GP34_in_Pin|GP35_in_Pin|GP36_in_Pin
                          |GP37_in_Pin|GP94_in_Pin|GP95_in_Pin|GP97_in_Pin;
  GPIO_InitStruct.Mode = GPIO_MODE_INPUT;
  GPIO_InitStruct.Pull = GPIO_NOPULL;
  HAL_GPIO_Init(GPIOJ, &GPIO_InitStruct);

  /*Configure GPIO pins : GP43_in_Pin GP44_in_Pin GP99_in_Pin GP100_in_Pin
                           GP101_in_Pin GP102_in_Pin GP108_in_Pin */
  GPIO_InitStruct.Pin = GP43_in_Pin|GP44_in_Pin|GP99_in_Pin|GP100_in_Pin
                          |GP101_in_Pin|GP102_in_Pin|GP108_in_Pin;
  GPIO_InitStruct.Mode = GPIO_MODE_INPUT;
  GPIO_InitStruct.Pull = GPIO_NOPULL;
  HAL_GPIO_Init(GPIOG, &GPIO_InitStruct);

  /*Configure GPIO pins : GP52_out_Pin GP61_out_Pin GP62_out_Pin GP63_out_Pin
                           GP64_out_Pin GP96_out_Pin */
  GPIO_InitStruct.Pin = GP52_out_Pin|GP61_out_Pin|GP62_out_Pin|GP63_out_Pin
                          |GP64_out_Pin|GP96_out_Pin;
  GPIO_InitStruct.Mode = GPIO_MODE_OUTPUT_PP;
  GPIO_InitStruct.Pull = GPIO_NOPULL;
  GPIO_InitStruct.Speed = GPIO_SPEED_FREQ_LOW;
  HAL_GPIO_Init(GPIOJ, &GPIO_InitStruct);

  /*Configure GPIO pins : CLK_STP5_Pin GP53_out_Pin GP54_out_Pin GP55_out_Pin
                           GP56_out_Pin GP78_out_Pin */
  GPIO_InitStruct.Pin = CLK_STP5_Pin|GP53_out_Pin|GP54_out_Pin|GP55_out_Pin
                          |GP56_out_Pin|GP78_out_Pin;
  GPIO_InitStruct.Mode = GPIO_MODE_OUTPUT_PP;
  GPIO_InitStruct.Pull = GPIO_NOPULL;
  GPIO_InitStruct.Speed = GPIO_SPEED_FREQ_LOW;
  HAL_GPIO_Init(GPIOH, &GPIO_InitStruct);

  /*Configure GPIO pins : USB_DEC_1_out_Pin GP57_out_Pin GP58_out_Pin GP59_out_Pin
                           GP60_out_Pin */
  GPIO_InitStruct.Pin = USB_DEC_1_out_Pin|GP57_out_Pin|GP58_out_Pin|GP59_out_Pin
                          |GP60_out_Pin;
  GPIO_InitStruct.Mode = GPIO_MODE_OUTPUT_PP;
  GPIO_InitStruct.Pull = GPIO_NOPULL;
  GPIO_InitStruct.Speed = GPIO_SPEED_FREQ_LOW;
  HAL_GPIO_Init(GPIOD, &GPIO_InitStruct);

  /*Configure GPIO pins : GP65_out_Pin GP66_out_Pin GP67_out_Pin GP104_out_Pin
                           GP107_out_Pin */
  GPIO_InitStruct.Pin = GP65_out_Pin|GP66_out_Pin|GP67_out_Pin|GP104_out_Pin
                          |GP107_out_Pin;
  GPIO_InitStruct.Mode = GPIO_MODE_OUTPUT_PP;
  GPIO_InitStruct.Pull = GPIO_NOPULL;
  GPIO_InitStruct.Speed = GPIO_SPEED_FREQ_LOW;
  HAL_GPIO_Init(GPIOK, &GPIO_InitStruct);

  /*Configure GPIO pins : GP68_out_Pin GP69_out_Pin GP70_out_Pin GP71_out_Pin
                           GP72_out_Pin GP73_out_Pin GP74_out_Pin GP98_out_Pin */
  GPIO_InitStruct.Pin = GP68_out_Pin|GP69_out_Pin|GP70_out_Pin|GP71_out_Pin
                          |GP72_out_Pin|GP73_out_Pin|GP74_out_Pin|GP98_out_Pin;
  GPIO_InitStruct.Mode = GPIO_MODE_OUTPUT_PP;
  GPIO_InitStruct.Pull = GPIO_NOPULL;
  GPIO_InitStruct.Speed = GPIO_SPEED_FREQ_LOW;
  HAL_GPIO_Init(GPIOG, &GPIO_InitStruct);

  /*Configure GPIO pin : PA8 */
  GPIO_InitStruct.Pin = GPIO_PIN_8;
  GPIO_InitStruct.Mode = GPIO_MODE_AF_PP;
  GPIO_InitStruct.Pull = GPIO_NOPULL;
  GPIO_InitStruct.Speed = GPIO_SPEED_FREQ_LOW;
  GPIO_InitStruct.Alternate = GPIO_AF0_MCO;
  HAL_GPIO_Init(GPIOA, &GPIO_InitStruct);

  /*Configure GPIO pins : GP86_in_Pin GP87_in_Pin GP88_in_Pin GP89_in_Pin
                           GP90_in_Pin GP91_in_Pin GP92_in_Pin GP93_in_Pin */
  GPIO_InitStruct.Pin = GP86_in_Pin|GP87_in_Pin|GP88_in_Pin|GP89_in_Pin
                          |GP90_in_Pin|GP91_in_Pin|GP92_in_Pin|GP93_in_Pin;
  GPIO_InitStruct.Mode = GPIO_MODE_INPUT;
  GPIO_InitStruct.Pull = GPIO_NOPULL;
  HAL_GPIO_Init(GPIOD, &GPIO_InitStruct);

  /*Configure GPIO pins : GP103_in_Pin GP105_in_Pin GP106_in_Pin */
  GPIO_InitStruct.Pin = GP103_in_Pin|GP105_in_Pin|GP106_in_Pin;
  GPIO_InitStruct.Mode = GPIO_MODE_INPUT;
  GPIO_InitStruct.Pull = GPIO_NOPULL;
  HAL_GPIO_Init(GPIOK, &GPIO_InitStruct);

  /*Configure GPIO pin : GP112_out_Pin */
  GPIO_InitStruct.Pin = GP112_out_Pin;
  GPIO_InitStruct.Mode = GPIO_MODE_OUTPUT_PP;
  GPIO_InitStruct.Pull = GPIO_NOPULL;
  GPIO_InitStruct.Speed = GPIO_SPEED_FREQ_LOW;
  HAL_GPIO_Init(GP112_out_GPIO_Port, &GPIO_InitStruct);

}

 /* MPU Configuration */

void MPU_Config(void)
{
  MPU_Region_InitTypeDef MPU_InitStruct = {0};

  /* Disables the MPU */
  HAL_MPU_Disable();

  /** Initializes and configures the Region and the memory to be protected
  */
  MPU_InitStruct.Enable = MPU_REGION_ENABLE;
  MPU_InitStruct.Number = MPU_REGION_NUMBER0;
  MPU_InitStruct.BaseAddress = 0x0;
  MPU_InitStruct.Size = MPU_REGION_SIZE_4GB;
  MPU_InitStruct.SubRegionDisable = 0x87;
  MPU_InitStruct.TypeExtField = MPU_TEX_LEVEL0;
  MPU_InitStruct.AccessPermission = MPU_REGION_NO_ACCESS;
  MPU_InitStruct.DisableExec = MPU_INSTRUCTION_ACCESS_DISABLE;
  MPU_InitStruct.IsShareable = MPU_ACCESS_SHAREABLE;
  MPU_InitStruct.IsCacheable = MPU_ACCESS_NOT_CACHEABLE;
  MPU_InitStruct.IsBufferable = MPU_ACCESS_NOT_BUFFERABLE;

  HAL_MPU_ConfigRegion(&MPU_InitStruct);
  /* Enables the MPU */
  HAL_MPU_Enable(MPU_PRIVILEGED_DEFAULT);

}

void Error_Handler(void)
{
  __disable_irq();
  while (1)
  {
  }
}
